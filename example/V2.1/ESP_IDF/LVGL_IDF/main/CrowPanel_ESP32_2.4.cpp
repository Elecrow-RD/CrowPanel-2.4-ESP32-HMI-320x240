#include "Arduino.h"
#include "freertos/FreeRTOS.h"
#include "freertos/task.h"
#include <lvgl.h>
#include <TFT_eSPI.h>
#include <DHT20.h>
#include "ui.h"

/*---------------------------------------------------------------
 * Display configuration
 * The LVGL canvas matches the physical 320 x 240 landscape display.
 * A partial buffer reduces RAM use while TFT_eSPI transfers each area.
 *--------------------------------------------------------------*/
static const uint16_t screenWidth = 320;
static const uint16_t screenHeight = 240;
static lv_color_t buf1[screenWidth * screenHeight / 8];

// Controls the TFT display and its resistive touch interface.
TFT_eSPI lcd = TFT_eSPI();

// Provides temperature and humidity measurements over I2C.
DHT20 dht20;

// Converts raw touch measurements into coordinates for this display.
uint16_t calData[5] = {189, 3416, 359, 3439, 1};

// Receives the LED state selected by the C-based generated UI event code.
extern "C" int led = 0;

// Stores the latest touch position returned by TFT_eSPI.
uint16_t touchX, touchY;

/**
 * @brief Transfer an LVGL drawing area to the physical LCD.
 *
 * LVGL calls this function whenever a rendered area is ready. The callback
 * must notify LVGL after the SPI transfer so the buffer can be reused.
 *
 * @param disp LVGL display requesting the transfer.
 * @param area Inclusive screen coordinates of the updated rectangle.
 * @param px_map Pixel data generated by LVGL for that rectangle.
 * @return Nothing.
 */
void my_disp_flush(lv_display_t *disp, const lv_area_t *area, uint8_t *px_map)
{
  // LVGL includes both boundary pixels in the dirty rectangle.
  uint32_t w = (area->x2 - area->x1 + 1);
  uint32_t h = (area->y2 - area->y1 + 1);

  // Transfer the rendered rectangle to the LCD over SPI.
  lcd.startWrite();
  lcd.setAddrWindow(area->x1, area->y1, w, h);
  lcd.pushColors((uint16_t *)px_map, w * h, true);
  lcd.endWrite();

  // Let LVGL reuse its partial buffer after the transfer completes.
  lv_display_flush_ready(disp);
}

/**
 * @brief Provide the current calibrated touch state and position to LVGL.
 *
 * LVGL calls this function while processing input devices. The X coordinate
 * is mirrored to match the landscape display orientation used by this build.
 *
 * @param indev LVGL input device requesting data.
 * @param data Destination for the state and transformed coordinates.
 * @return Nothing.
 */
void my_touchpad_read(lv_indev_t * indev, lv_indev_data_t * data)
{
  // 400 is the pressure threshold used by this ESP-IDF calibration.
  bool touched = lcd.getTouch(&touchX, &touchY, 400);
  if (!touched)
  {
    // Report release so LVGL can complete and cancel touch gestures correctly.
    data->state = LV_INDEV_STATE_RELEASED;
  }
  else
  {
    // Mirror X because the installed landscape orientation reverses that axis.
    data->state = LV_INDEV_STATE_PRESSED;
    data->point.x = screenWidth - touchX;
    data->point.y = touchY;
  }
}

/**
 * @brief Initialize the board and run the LVGL application task loop.
 *
 * ESP-IDF calls app_main() once after the scheduler and registered components
 * are ready. The function initializes Arduino compatibility before using its
 * peripheral APIs, then remains active as the application's main task.
 *
 * @param None.
 * @return Nothing; the function contains the permanent application loop.
 */
extern "C" void app_main()
{
  /*---------------------------------------------------------------
   * Start Arduino compatibility and basic peripherals
   * The LED begins off, and the DHT20 uses a 100 kHz I2C bus on GPIO22/21.
   *--------------------------------------------------------------*/
  initArduino();
  Serial.begin(115200);

  pinMode(25, OUTPUT);
  digitalWrite(25, LOW);

  Wire.begin(22, 21);
  Wire.setClock(100000);
  delay(100);
  if (dht20.begin() != 0) {
    Serial.println("DHT20 init failed");
  }

  /*---------------------------------------------------------------
   * Initialize LVGL and the display hardware
   * Keep the backlight off until the LCD controller has been cleared.
   *--------------------------------------------------------------*/
  lv_init();
  lv_tick_set_cb(millis);

  lcd.begin();
  lcd.fillScreen(TFT_BLACK);
  delay(300);
  pinMode(27, OUTPUT);
  digitalWrite(27, HIGH);
  lcd.setRotation(1);
  lcd.setTouch(calData);

  /*---------------------------------------------------------------
   * Register the LVGL display and touch devices
   * LVGL uses these callbacks to move pixels to the LCD and obtain input.
   *--------------------------------------------------------------*/
  lv_display_t *disp = lv_display_create(screenWidth, screenHeight);
  lv_display_set_flush_cb(disp, my_disp_flush);
  lv_display_set_buffers(disp, buf1, NULL, sizeof(buf1), LV_DISPLAY_RENDER_MODE_PARTIAL);

  lv_indev_t *indev = lv_indev_create();
  lv_indev_set_type(indev, LV_INDEV_TYPE_POINTER);
  lv_indev_set_read_cb(indev, my_touchpad_read);

  ui_init();

  uint32_t last_sensor_ms = 0;

  /*---------------------------------------------------------------
   * Run the application
   * Service LVGL every pass, update sensor labels once per second, and
   * continuously apply the LED state selected by the UI.
   *--------------------------------------------------------------*/
  while (1)
  {
    lv_timer_handler();

    // Limiting sensor reads avoids unnecessary I2C traffic and UI updates.
    uint32_t now = millis();
    if (now - last_sensor_ms >= 1000) {
      last_sensor_ms = now;
      // Read both values together so labels update from one sensor sample.
      int temperature = 0;
      int humidity = 0;
      if (dht20.readTempHumidity(&temperature, &humidity) == 0) {
        char dht_buffer[8];
        // Convert each integer reading to label text and reuse the buffer.
        snprintf(dht_buffer, sizeof(dht_buffer), "%d", temperature);
        lv_label_set_text(ui_Label1, dht_buffer);
        snprintf(dht_buffer, sizeof(dht_buffer), "%d", humidity);
        lv_label_set_text(ui_Label2, dht_buffer);
      }
    }

    digitalWrite(25, led ? HIGH : LOW);
    vTaskDelay(pdMS_TO_TICKS(10));
  }
}
