#include <lvgl.h>
#include <TFT_eSPI.h>
#include <Arduino.h>
#include <Crowbits_DHT20.h>
#include "ui.h"

// Receives the LED state selected by the generated UI event code.
int led;

/*---------------------------------------------------------------
 * Display configuration
 * The LVGL canvas matches the physical 320 x 240 landscape display.
 * A partial buffer reduces RAM use while TFT_eSPI transfers each area.
 *--------------------------------------------------------------*/
static const uint16_t screenWidth = 320;
static const uint16_t screenHeight = 240;
static lv_color_t buf1[screenWidth * screenHeight / 8];

// Controls the TFT display and its touch controller.
TFT_eSPI lcd = TFT_eSPI();

// Provides temperature and humidity readings over the I2C bus.
Crowbits_DHT20 dht20;

// Stores the latest touch position returned by TFT_eSPI.
uint16_t touchX, touchY;

// Retains serial data storage included by the original example.
unsigned char buffer[256];

// Tracks the number of valid bytes currently held in buffer.
int count = 0;

/**
 * @brief Transfer an LVGL drawing area to the physical LCD.
 *
 * LVGL calls this function whenever a rendered area is ready. The callback
 * must notify LVGL after the SPI transfer so the buffer can be reused.
 *
 * @param disp LVGL display requesting the transfer.
 * @param area Inclusive screen coordinates of the updated rectangle.
 * @param px_map Pixel data generated by LVGL for that rectangle.
 * @return Nothing.
 */
void my_disp_flush(lv_display_t *disp, const lv_area_t *area, uint8_t *px_map)
{
  // LVGL's area coordinates are inclusive, so both dimensions need +1.
  uint32_t w = (area->x2 - area->x1 + 1);
  uint32_t h = (area->y2 - area->y1 + 1);

  // Send the rendered rectangle to the LCD over the TFT_eSPI transaction.
  lcd.startWrite();
  lcd.setAddrWindow(area->x1, area->y1, w, h);
  lcd.pushColors((uint16_t *)px_map, w * h, true);
  lcd.endWrite();

  // Tell LVGL that the buffer is free for the next partial render.
  lv_display_flush_ready(disp);
}

/**
 * @brief Provide the current touch state and position to LVGL.
 *
 * LVGL calls this function while processing input devices. Only touches
 * that pass the TFT_eSPI pressure threshold are reported as pressed.
 *
 * @param indev LVGL input device requesting data.
 * @param data Destination for the state and calibrated coordinates.
 * @return Nothing.
 */
void my_touchpad_read(lv_indev_t * indev, lv_indev_data_t * data)
{
  // 600 is the TFT_eSPI pressure threshold used to reject noise and false touches.
  bool touched = lcd.getTouch(&touchX, &touchY, 600);
  if (!touched)
  {
    // Report release so LVGL does not keep the previous point pressed.
    data->state = LV_INDEV_STATE_RELEASED;
  }
  else
  {
    // Forward the calibrated touch state and coordinates to LVGL.
    data->state = LV_INDEV_STATE_PRESSED;

    data->point.x = touchX;
    data->point.y = touchY;

    // Serial output makes touch calibration and orientation easy to verify.
    Serial.print("Data x ");
    Serial.println(touchX);

    Serial.print("Data y ");
    Serial.println(touchY);
  }
}

/**
 * @brief Clear the used portion of the retained serial buffer.
 *
 * Call this helper after buffer contains count valid bytes and those bytes
 * are no longer needed. It is provided for the serial workflow retained in
 * this sketch, although the current loop does not call it.
 *
 * @param None.
 * @return Nothing.
 */
void clearBufferArray()
{
  for (int i = 0; i < count; i++)
  {
    buffer[i] = NULL;
  }
}

/**
 * @brief Initialize the board peripherals, LVGL display, touch input, and UI.
 *
 * Arduino calls this function once after startup or reset. The generated UI
 * is created only after display and input callbacks have been registered.
 *
 * @param None.
 * @return Nothing.
 */
void setup()
{
  Serial.begin(115200);
  Serial2.begin(9600);

  /*---------------------------------------------------------------
   * Initialize the LED and DHT20 sensor
   * The UI later changes led, while the loop applies that value to GPIO25.
   *--------------------------------------------------------------*/
  pinMode(25, OUTPUT);
  digitalWrite(25, LOW);

  Wire.begin(22, 21);
  dht20.begin();

  lv_init();
  lv_tick_set_cb(millis);

  /*---------------------------------------------------------------
   * Initialize the LCD and backlight
   * Keep the backlight off until the controller has been cleared.
   *--------------------------------------------------------------*/
  lcd.begin();
  lcd.fillScreen(TFT_BLACK);
  delay(300);
  pinMode(27, OUTPUT);
  digitalWrite(27, HIGH);
  lcd.setRotation(1);

  /*---------------------------------------------------------------
   * Register the LVGL display and touch devices
   * LVGL uses these callbacks to move pixels to the LCD and obtain input.
   *--------------------------------------------------------------*/
  lv_display_t *disp = lv_display_create(screenWidth, screenHeight);
  lv_display_set_flush_cb(disp, my_disp_flush);
  lv_display_set_buffers(disp, buf1, NULL, sizeof(buf1), LV_DISPLAY_RENDER_MODE_PARTIAL);

  lv_indev_t *indev = lv_indev_create();
  lv_indev_set_type(indev, LV_INDEV_TYPE_POINTER);
  lv_indev_set_read_cb(indev, my_touchpad_read);

  ui_init();
}

/**
 * @brief Update sensor labels, apply the UI LED state, and service LVGL.
 *
 * Arduino calls this function repeatedly after setup() finishes. The short
 * delay leaves time for the system while keeping touch and UI updates fluid.
 *
 * @param None.
 * @return Nothing.
 */
void loop()
{
  Serial.print(led);

  /*---------------------------------------------------------------
   * Refresh the temperature and humidity labels
   * Convert each integer reading to text because LVGL labels accept strings.
   *--------------------------------------------------------------*/
  char DHT_buffer[6];
  int a = (int)dht20.getTemperature();
  int b = (int)dht20.getHumidity();
  snprintf(DHT_buffer, sizeof(DHT_buffer), "%d", a);
  // LVGL labels receive text, so convert the temperature before updating it.
  lv_label_set_text(ui_Label1, DHT_buffer);
  snprintf(DHT_buffer, sizeof(DHT_buffer), "%d", b);
  // Reuse the buffer for humidity after the temperature label has been updated.
  lv_label_set_text(ui_Label2, DHT_buffer);

  // Apply the state selected by the generated ON/OFF button callbacks.
  /*---------------------------------------------------------------
   * Apply the UI-selected LED state
   * The generated event callbacks set led to either 1 or 0.
   *--------------------------------------------------------------*/
  if (led == 1) {
    digitalWrite(25, HIGH);
    Serial.print("led_on");
  }

  if (led == 0) {
    digitalWrite(25, LOW);
    Serial.print("led_off");
  }

  // Service LVGL timers, redraws, and pending touch events.
  lv_timer_handler();
  // Yield briefly so the UI remains responsive while the loop repeats.
  delay(10);
}
